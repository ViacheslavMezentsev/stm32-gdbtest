# TeachingGPIO register map
File version: 1
Two modeled inputs; not an STM32 electrical model
Registers are 32-bit, read-only, no defined reset value unless marked. A register's access mark holds for its fields unless they carry their own. Offsets are from the block's base; lines under a group give offsets from that group; [hi:lo] are bit positions; {n}, {i} and the like mark numbered series; 'fields as' and 'values as' point back to an identical list; <NAME> marks a mode.

## Memory map
0x40000000 GPIO — Teaching input

## GPIO — Teaching input
Base 0x40000000
0x00 IDR — Input levels, writes ignored
