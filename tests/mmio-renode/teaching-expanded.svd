# TeachingMMIO register map
Neutral model, not STM32
Registers are 32-bit, write-only, no defined reset value unless marked. A register's access mark holds for its fields unless they carry their own. Offsets are from the block's base; lines under a group give offsets from that group; [hi:lo] are bit positions; {n}, {i} and the like mark numbered series; 'fields as' and 'values as' point back to an identical list; <NAME> marks a mode.

## Memory map
0x40000000 MODEL
0x40000000 MIRROR

## MODEL
Base 0x40000000
0x00 RW rw
0x00 SLOTS group
  {0x0+4j} DATA{j} (j=0..1)
0x04 WO
0x08 RTC ro read-clears
0x0C W1C write-1-clears
0x10 FIFO ro read-has-side-effects
0x14 TICKS ro read-modifies
0x18 SENTINEL rw

## MIRROR
Base 0x40000000
0x00 PORT group
  {0x0+4j} DATA{j} (j=0..1)
0x0C ACK write-1-clears
